## sdkconfig.defaults
```kconfig
CONFIG_ESPTOOLPY_BAUD_921600B=y
CONFIG_FLASHMODE_DOUT=y
CONFIG_ESPTOOLPY_FLASHSIZE_4MB=y
CONFIG_PARTITION_TABLE_CUSTOM=y
CONFIG_PARTITION_TABLE_CUSTOM_FILENAME="partitions_esp8266.csv"
CONFIG_MQTT_USING_ESP=y
```
